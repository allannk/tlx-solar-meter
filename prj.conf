## CMakeLists.txt
```
cmake_minimum_required(VERSION 3.29.1)

# ──────────────────────────────────────────────────
#   General configuration
# ──────────────────────────────────────────────────
set(USE_CCACHE 0)

list(APPEND BOARD_ROOT ${CMAKE_CURRENT_SOURCE_DIR}/../..)
list(APPEND ZEPHYR_EXTRA_MODULES ${CMAKE_CURRENT_SOURCE_DIR}/../..)
list(APPEND DTS_ROOT ${CMAKE_CURRENT_SOURCE_DIR}/../..)

# list(APPEND DTC_OVERLAY_FILE ${CMAKE_CURRENT_SOURCE_DIR}/board.overlay)
find_package(Zephyr)
project(tlx-solar-meter)

# Set repository root directory
set(REPO_ROOT "${CMAKE_CURRENT_SOURCE_DIR}/../../")

# ──────────────────────────────────────────────────
#   Source code
# ──────────────────────────────────────────────────
include_directories("src")
include_directories(${REPO_ROOT}/include)

target_sources(app PRIVATE
    src/main.c
)
```

## prj.conf
```kconfig
# ────────────────────────────────────────────────
# ❱ Console subsystem
# ────────────────────────────────────────────────
CONFIG_CONSOLE=y
CONFIG_UART_CONSOLE=y
CONFIG_PRINTK=y
CONFIG_LOG=y

# ────────────────────────────────────────────────
# ❱ Shell subsystem
# ────────────────────────────────────────────────
CONFIG_SHELL=y
CONFIG_SHELL_MINIMAL=n

# Shell modules
CONFIG_GPIO_SHELL=n
CONFIG_KERNEL_SHELL=n

# ────────────────────────────────────────────────
# ❱ Miscellaneous
# ────────────────────────────────────────────────
# Enable stack trace for `west debug`
CONFIG_DEBUG_THREAD_INFO=y
CONFIG_DEBUG=n
```

## src/main.c
```c
#include <zephyr/drivers/gpio.h>
#include <zephyr/kernel.h>
// #include <zephyr/logging/log.h>

int main(void) {
    // LOG_INF("Booted MCU");
    __asm("nop");
}

// K_THREAD_DEFINE(heartbeat_tid, 1024, heartbeat_fn, NULL, NULL, NULL, 5, 0, 500);
```
